## boards/shields/tsungyu_split/Kconfig.defconfig
```kconfig
if SHIELD_TSUNGYU_SPLIT_LEFT

config ZMK_KEYBOARD_NAME
    default "tsungyu-split-2"

config ZMK_SPLIT_ROLE_CENTRAL
    default y

endif # SHIELD_TSUNGYU_SPLIT_LEFT

if SHIELD_TSUNGYU_SPLIT_LEFT || SHIELD_TSUNGYU_SPLIT_RIGHT

config ZMK_SPLIT
    default y

endif # SHIELD_TSUNGYU_SPLIT_LEFT || SHIELD_TSUNGYU_SPLIT_RIGHT
```

## firmware/boards/shields/tsungyu_split/Kconfig.shield
```kconfig
config SHIELD_TSUNGYU_SPLIT_LEFT
    def_bool $(shields_list_contains,tsungyu_split_left)

config SHIELD_TSUNGYU_SPLIT_RIGHT
    def_bool $(shields_list_contains,tsungyu_split_right)
```
